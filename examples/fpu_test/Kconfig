## examples/fpu_test/Kconfig
```kconfig
#
# For a description of the syntax of this configuration file,
# see the file kconfig-language.txt in the NuttX tools repository.
#

config EXAMPLES_FPU_TEST
	tristate "\"FPU TEST sample!\" example"
	default n
	---help---
		Enable the \"FPU TEST sample!\" example

if EXAMPLES_FPU_TEST

config EXAMPLES_FPU_TEST_PROGNAME
	string "Program name"
	default "fpu_test"
	---help---
		This is the name of the program that will be used when the NSH ELF
		program is installed.

config EXAMPLES_FPU_TEST_PRIORITY
	int "FPU_TEST task priority"
	default 105

config EXAMPLES_FPU_TEST_STACKSIZE
	int "FPU_TEST stack size"
	default DEFAULT_TASK_STACKSIZE

endif
```
